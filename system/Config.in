## system/Config.in
```kconfig
source "$BR2_EXTERNAL_CRYSTALINE_PATH/package/exfatprogs-upstream/Config.in"
source "$BR2_EXTERNAL_CRYSTALINE_PATH/package/linux-perf/Config.in"
source "$BR2_EXTERNAL_CRYSTALINE_PATH/package/libmali/Config.in"
source "$BR2_EXTERNAL_CRYSTALINE_PATH/package/vulkan-wsi-layer/Config.in"
source "$BR2_EXTERNAL_CRYSTALINE_PATH/package/vkmark/Config.in"
```

## system/package/exfatprogs-upstream/Config.in
```kconfig
config BR2_PACKAGE_EXFATPROGS_UPSTREAM
	bool "exfatprogs-upstream"
	depends on BR2_USE_WCHAR
	depends on !BR2_PACKAGE_EXFATPROGS
	select BR2_PACKAGE_UTIL_LINUX
	select BR2_PACKAGE_UTIL_LINUX_LIBBLKID
	help
	  exFAT tools (fsck.exfat, mkfs.exfat, exfatlabel, ...) from
	  exfatprogs 1.4, for fsck.exfat's repair fixes since the 1.2
	  release Buildroot packages. Named exfatprogs-upstream because
	  Buildroot's exfatprogs package already uses the EXFATPROGS_*
	  make variables; both install the same programs, so only one
	  can be enabled.

comment "exfatprogs-upstream needs a toolchain w/ wchar"
	depends on !BR2_USE_WCHAR
```

## system/package/libmali/Config.in
```kconfig
config BR2_PACKAGE_LIBMALI
	bool "libmali"
	depends on BR2_aarch64
	depends on BR2_TOOLCHAIN_USES_GLIBC
	depends on BR2_INSTALL_LIBSTDCPP
	select BR2_PACKAGE_LIBDRM
	help
	  ARM's closed GL ES, EGL, GBM and Vulkan driver for Mali GPUs
	  (needs ARM's kernel driver, mali_kbase), as Rockchip ships
	  it: the Mali-G52 (Bifrost) build g29p1 that ROCKNIX uses on
	  the RK3566. Installed beside Mesa in /usr/lib/mali; the
	  device uses it only when chosen (start-up hooks).

	  https://github.com/JeffyCN/mirrors/tree/libmali
```

## system/package/linux-perf/Config.in
```kconfig
config BR2_PACKAGE_LINUX_PERF
	bool "linux-perf"
	depends on BR2_USE_WCHAR && !BR2_STATIC_LIBS && BR2_TOOLCHAIN_HAS_THREADS # elfutils
	select BR2_PACKAGE_ELFUTILS
	select BR2_PACKAGE_ZLIB
	select BR2_PACKAGE_ZSTD
	help
	  perf, the kernel's profiler, from kernel.org's standalone perf
	  release. Buildroot's own (linux-tools) needs a kernel built by
	  Buildroot, and ours isn't. Not named "perf": linux-tools
	  already defines that package's variables.
```

## system/package/vkmark/Config.in
```kconfig
config BR2_PACKAGE_VKMARK
	bool "vkmark"
	depends on BR2_PACKAGE_VULKAN_LOADER
	depends on BR2_INSTALL_LIBSTDCPP
	select BR2_PACKAGE_ASSIMP
	select BR2_PACKAGE_GLM
	select BR2_PACKAGE_LIBDRM
	select BR2_PACKAGE_VULKAN_HEADERS
	help
	  Vulkan benchmark, with its window systems for the panel
	  (display: VK_KHR_display; kms: through GBM) and headless.

	  https://github.com/vkmark/vkmark
```

## system/package/vulkan-wsi-layer/Config.in
```kconfig
config BR2_PACKAGE_VULKAN_WSI_LAYER
	bool "vulkan-wsi-layer"
	depends on BR2_PACKAGE_VULKAN_LOADER
	depends on BR2_INSTALL_LIBSTDCPP
	select BR2_PACKAGE_LIBDRM
	select BR2_PACKAGE_VULKAN_HEADERS
	help
	  ARM's Vulkan layer that adds window-system support (here: the
	  panel through KMS, VK_KHR_display, and headless surfaces) to
	  Vulkan drivers without their own, such as ARM's libmali.
	  Built with ROCKNIX's choice of fork and commit.

	  https://github.com/ginkage/vulkan-wsi-layer
```
