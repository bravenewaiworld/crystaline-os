## system/package/libmali/Config.in
```kconfig
config BR2_PACKAGE_LIBMALI
	bool "libmali"
	depends on BR2_aarch64
	depends on BR2_TOOLCHAIN_USES_GLIBC
	depends on BR2_INSTALL_LIBSTDCPP
	select BR2_PACKAGE_LIBDRM
	help
	  ARM's closed GL ES, EGL, GBM and Vulkan driver for Mali GPUs
	  (needs ARM's kernel driver, mali_kbase), as Rockchip ships
	  it. Installed beside Mesa in /usr/lib/mali; the device uses
	  it only when chosen (start-up hooks).

	  https://github.com/JeffyCN/mirrors/tree/libmali

config BR2_PACKAGE_LIBMALI_LIB
	string "library"
	depends on BR2_PACKAGE_LIBMALI
	help
	  The build for the SoC's GPU, a file of the mirror's
	  lib/aarch64-linux-gnu/, e.g. libmali-bifrost-g52-g29p1.so
	  (the RK3566's Mali-G52). Set by the SoC's buildroot.config.
```
